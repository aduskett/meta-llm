## conf/layer.conf
```bitbake
BBPATH .= ":${LAYERDIR}"

BBFILES += "\
    ${LAYERDIR}/recipes*/*/*.bb \
    ${LAYERDIR}/recipes*/*/*.bbappend \
"

BBFILE_COLLECTIONS += "meta-llm"
BBFILE_PATTERN_meta-llm := "^${LAYERDIR}/"
BBFILE_PRIORITY_meta-llm = "10"
LAYERSERIES_COMPAT_meta-llm = "blacksail"

LAYERDEPENDS_meta-llm += "\
    core \
    openembedded-layer \
"

LICENSE_PATH += "${LAYERDIR}/licenses"

HOSTTOOLS_NONFATAL += "free"
```
